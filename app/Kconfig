## app/Kconfig
```kconfig
menu "Zephyr Kernel"
    source "Kconfig.zephyr"
endmenu

menu "Meshbus Firmware"
    menu "Logging"
        module = APP
        module-str = APP
        source "subsys/logging/Kconfig.template.log_config"
    endmenu
endmenu
```

## app/west.yml
```yaml
manifest:
  remotes:
    - name: zephyrproject
      url-base: https://github.com/zephyrproject-rtos
    - name: meshbus
      url-base: https://github.com/meshbus
  projects:
    - name: zephyr
      repo-path: zephyr
      remote: zephyrproject
      revision: main
      import: true
    - name: meshbus-sdk
      repo-path: meshbus-sdk
      remote: meshbus
      revision: main
      path: meshbus
```
